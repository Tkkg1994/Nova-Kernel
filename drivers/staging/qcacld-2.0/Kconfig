## drivers/staging/qcacld-2.0/Kconfig
```kconfig
comment "Qualcomm Atheros CLD WLAN module"

config QCA_CLD_WLAN

	tristate "Qualcomm Atheros CLD WLAN module"
	default n
	help
	Add support for the Qualcomm Atheros CLD WLAN module

if QCA_CLD_WLAN != n

config CONFIG_PRIMA_WLAN_BTAMP
	bool "Enable BlueTooth AMP feature"
	default n

config PRIMA_WLAN_OKC
	bool "Enable the Prima WLAN Opportunistic Key Caching feature"
	default y

config PRIMA_WLAN_LFR
	bool "Enable the Prima WLAN Legacy Fast Roaming feature"
	default y

config PRIMA_WLAN_11AC_HIGH_TP
	bool "Enable the Prima WLAN 802.11ac High Throughput option (depends upon kernel support)"
	default y

config QCOM_VOWIFI_11R
	bool "Enable Fast Transition (11r) feature"
	default y

config QCOM_TDLS
	bool "Enable TDLS feature"
	default y

config WLAN_FEATURE_11W
	depends on CNSS
	bool "Enable the WLAN 802.11w Protected Management Frames feature"
	default y

config QCOM_LTE_COEX
	depends on CNSS
	bool "Enable QCOM LTE Coex feature"
	default y

config ENABLE_LINUX_REG
	bool "Enable linux regulatory feature"
	default y

endif # QCA_CLD_WLAN
```

## drivers/staging/vnswap/Kconfig
```kconfig
config VNSWAP
	tristate "Fake device for swap"
	depends on BLOCK && SYSFS && ZSWAP || ZSWAP_SAMSUNG
	default n
```
